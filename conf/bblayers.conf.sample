## conf/bblayers.conf.sample
```bitbake
# POKY_BBLAYERS_CONF_VERSION is increased each time build/conf/bblayers.conf
# changes incompatibly
POKY_BBLAYERS_CONF_VERSION = "1"

BBPATH = "${TOPDIR}"
BBFILES ?= ""

BBLAYERS ?= " \
  ##OEROOT##/poky/meta \
  ##OEROOT##/poky/meta-poky \
  ##OEROOT##/poky/meta-yocto-bsp \
  ##OEROOT##/meta-raspberrypi \
  ##OEROOT##/meta-chik \
  "
```
